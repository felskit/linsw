## Lab3/felskit-lab3-archive/user/package/python-magic/Config.in
```kconfig
config BR2_PACKAGE_PYTHON_MAGIC
	bool "python-magic"
	depends on BR2_PACKAGE_PYTHON3
	help
	  Python interface to the libmagic
	  file type identification library

comment "python-magic needs python3"
	depends on !BR2_PACKAGE_PYTHON3
```

## lab1/felskit-lab1-archive/package/python-welcome/Config.in
```kconfig
config BR2_PACKAGE_PYTHON_WELCOME
	bool "python-welcome"
	depends on BR2_PACKAGE_PYTHON
	help
	  Python welcome script.

	  https://www.python.org/

comment "python-welcome needs python"
	depends on !BR2_PACKAGE_PYTHON
```

## lab2/felskit-lab2-archive/package/gpio-counter/Config.in
```kconfig
config BR2_PACKAGE_GPIO_COUNTER
	bool "gpio-counter"
	help
	  Binary counter using GPIO.

	  https://github.com/felskit
```
